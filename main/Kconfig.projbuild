## main/Kconfig.projbuild
```kconfig
menu "Default Wifi Configuration"
    config STA_SSID
        string "STA SSID"
        default "MatterDemo"
        help
            WiFi SSID

    config STA_PASSPHRASE
        string "STA PASSPHRASE"
        default "1234567789"
        help
            WiFi Passphrase

    config RETRY_CONNECT
        int "Retry to connect"
        default 5
        help
            The number of attempts to connect to wifi

endmenu
```

## sdkconfig.defaults
```kconfig
# Reduce bootloader log verbosity
CONFIG_BOOTLOADER_LOG_LEVEL_WARN=y
CONFIG_BOOTLOADER_LOG_LEVEL=2

# Increase main task stack size
CONFIG_ESP_MAIN_TASK_STACK_SIZE=7168

# Enable filesystem
CONFIG_PARTITION_TABLE_CUSTOM=y
CONFIG_PARTITION_TABLE_CUSTOM_FILENAME="partitions.csv"
CONFIG_PARTITION_TABLE_FILENAME="partitions.csv"

# Enable FreeRTOS stats formatting functions, needed for 'tasks' command
CONFIG_FREERTOS_USE_TRACE_FACILITY=y
CONFIG_FREERTOS_USE_STATS_FORMATTING_FUNCTIONS=y

CONFIG_ESPTOOLPY_FLASHSIZE_4MB=y

# Camera
# CONFIG_OV7670_SUPPORT=y
# CONFIG_SCCB_HARDWARE_I2C_PORT1=y
# CONFIG_SCCB_CLK_FREQ=100000
# CONFIG_CAMERA_TASK_STACK_SIZE=2048
# CONFIG_CAMERA_CORE0=y
# CONFIG_CAMERA_DMA_BUFFER_SIZE_MAX=32768

# CONFIG_SPIRAM=y
# CONFIG_SPIRAM_TYPE_ESPPSRAM32=y
# CONFIG_SPIRAM_SPEED_80M=y
```
